#include "SSD1306.h"

// Kompakter 5x7 Font (mit 0-Offset für ASCII-Zeichen von 32 bis 127)
// Jedes Zeichen ist 5 Spalten breit (jeweils 1 Byte pro Spalte, LSB oben)
static const uint8_t PROGMEM ssd1306_font[][5] = {
    {0x00, 0x00, 0x00, 0x00, 0x00}, // (space)
    {0x00, 0x00, 0x5F, 0x00, 0x00}, // !
    {0x00, 0x07, 0x00, 0x07, 0x00}, // "
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    {0x7F, 0x7F, 0x7F, 0x7F, 0x7F}  // block (127)
};

SSD1306::SSD1306(uint8_t address, uint8_t sda, uint8_t scl)
    : _address(address), _sda(sda), _scl(scl) {}

bool SSD1306::begin() {
    Wire.begin(_sda, _scl);
    Wire.setClock(400000); // 400kHz Fast I2C

    // Testen, ob Display an I2C-Adresse antwortet
    Wire.beginTransmission(_address);
    if (Wire.endTransmission() != 0) {
        Serial.println("[SSD1306] Display nicht gefunden an Adresse 0x" + String(_address, HEX));
        return false;
    }

    // SSD1306 Initialisierungs-Befehlssequenz für 128x64 Auflösung
    const uint8_t initCmds[] = {
        0xAE,       // Display aus (Sleep Mode)
        0xD5, 0x80, // Set Display Clock Divide Ratio/Oscillator Frequency
        0xA8, 0x3F, // Set Multiplex Ratio (64)
        0xD3, 0x00, // Set Display Offset (0)
        0x40,       // Set Display Start Line (0)
        0x8D, 0x14, // Charge Pump einschalten (wichtig für Kontrast)
        0x20, 0x02, // Set Memory Addressing Mode auf Page Addressing Mode (0x02)
        0xA1,       // Set Segment Re-map (A1 = Spalte 127 wird Segment 0, d.h. horizontal gespiegelt für korrekten Einbau)
        0xC8,       // Set COM Output Scan Direction (C8 = von oben nach unten gespiegelt)
        0xDA, 0x12, // Set COM Pins Hardware Configuration
        0x81, 0xCF, // Kontrast auf hohen Wert setzen (0xCF)
        0xD9, 0xF1, // Set Pre-charge Period
        0xDB, 0x40, // Set VCOMH Deselect Level
        0xA4,       // Entire Display On (Resume to GDDRAM content)
        0xA6,       // Normaler Modus (nicht invertiert)
        0x2E,       // Deaktiviert kontinuierliches Scrolling
        0xAF        // Display an
    };

    for (size_t i = 0; i < sizeof(initCmds); ++i) {
        sendCommand(initCmds[i]);
    }

    clear();
    return true;
}

void SSD1306::sendCommand(uint8_t command) {
    Wire.beginTransmission(_address);
    Wire.write(0x00); // Control-Byte: Co=0, D/C#=0 (Folgende Bytes sind Befehle)
    Wire.write(command);
    Wire.endTransmission();
}

void SSD1306::sendData(const uint8_t* data, size_t size) {
    size_t offset = 0;
    while (offset < size) {
        size_t chunk = size - offset;
        if (chunk > 16) chunk = 16; // In kleinen Häppchen senden, da ESP8266 Wire-Buffer begrenzt ist (meist 32 Bytes)

        Wire.beginTransmission(_address);
        Wire.write(0x40); // Control-Byte: Co=0, D/C#=1 (Folgende Bytes sind Daten)
        Wire.write(data + offset, chunk);
        Wire.endTransmission();

        offset += chunk;
    }
}

void SSD1306::clear() {
    // 8 Pages löschen
    for (uint8_t page = 0; page < 8; ++page) {
        setCursor(0, page);
        uint8_t zeroBuffer[16];
        std::memset(zeroBuffer, 0, sizeof(zeroBuffer));
        // 128 Spalten pro Page auf 0 setzen
        for (uint8_t i = 0; i < 8; ++i) {
            sendData(zeroBuffer, sizeof(zeroBuffer));
        }
    }
    setCursor(0, 0);
}

void SSD1306::setPowerSave(bool enable) {
    // 0xAE = Display aus, 0xAF = Display an
    sendCommand(enable ? 0xAE : 0xAF);
}

void SSD1306::setCursor(uint8_t col, uint8_t page) {
    if (col >= 128) col = 127;
    if (page >= 8) page = 7;

    // Setze Spaltenadresse (Low-Nibble und High-Nibble im Page-Mode)
    sendCommand(0x00 | (col & 0x0F));
    sendCommand(0x10 | ((col >> 4) & 0x0F));
    // Setze Page-Adresse
    sendCommand(0xB0 | page);
}

size_t SSD1306::write(char c) {
    uint8_t charIndex = 0;
    if (c >= 32 && c <= 127) {
        charIndex = c - 32;
    } else {
        charIndex = 127 - 32; // Unbekannte Zeichen als Block anzeigen
    }

    uint8_t glyph[6];
    // Lese 5 Bytes Spaltenmuster aus PROGMEM
    for (uint8_t col = 0; col < 5; ++col) {
        glyph[col] = pgm_read_byte(&(ssd1306_font[charIndex][col]));
    }
    glyph[5] = 0x00; // 1 Pixel Leerraum zur Zeichentrennung

    sendData(glyph, 6);
    return 1;
}

void SSD1306::print(const char* str) {
    while (*str) {
        write(*str++);
    }
}

void SSD1306::printWrapped(const String& str, uint8_t startPage, uint8_t maxPages) {
    uint8_t currentPage = startPage;
    uint8_t maxLimitPage = startPage + maxPages;
    if (maxLimitPage > 8) maxLimitPage = 8;

    setCursor(0, currentPage);

    uint8_t colCount = 0;
    size_t i = 0;
    while (i < str.length() && currentPage < maxLimitPage) {
        char c = str[i];

        // Expliziten Zeilenumbruch beachten
        if (c == '\n') {
            currentPage++;
            if (currentPage < maxLimitPage) {
                setCursor(0, currentPage);
            }
            colCount = 0;
            i++;
            continue;
        }

        // Zeilenumbruch nach 21 Zeichen (128 Pixel / 6 Pixel pro Zeichen = 21.3)
        if (colCount >= 21) {
            currentPage++;
            if (currentPage < maxLimitPage) {
                setCursor(0, currentPage);
            }
            colCount = 0;
        }

        if (currentPage < maxLimitPage) {
            write(c);
            colCount++;
        }
        i++;
    }

    // Restliche Pages dieser Box leeren, um alten Text rückstandslos zu überschreiben
    while (currentPage < maxLimitPage) {
        // Leere bis zum Ende der aktuellen Zeile
        uint8_t remainingCols = 128 - (colCount * 6);
        if (remainingCols > 0) {
            uint8_t zeroBuffer[16];
            std::memset(zeroBuffer, 0, sizeof(zeroBuffer));
            while (remainingCols > 0) {
                size_t toSend = remainingCols > 16 ? 16 : remainingCols;
                sendData(zeroBuffer, toSend);
                remainingCols -= toSend;
            }
        }
        currentPage++;
        colCount = 0;
        if (currentPage < maxLimitPage) {
            setCursor(0, currentPage);
        }
    }
}

void SSD1306::drawPattern(const uint8_t* data) {
    sendData(data, 8);
}
